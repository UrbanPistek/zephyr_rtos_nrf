## CMakeLists.txt
```
#-------------------------------------------------------------------------------
# Zephyr Application
#

cmake_minimum_required(VERSION 3.13.1)
find_package(Zephyr REQUIRED HINTS $ENV{ZEPHYR_BASE})

project(app LANGUAGES C VERSION 1.0.0)
target_include_directories(app PRIVATE ${CMAKE_BINARY_DIR}/app/include src include)
target_sources(app PRIVATE 
    src/main.c
    src/ble.c
)
```

## prj.conf
```kconfig
# This file contains selected Kconfig options for the application.

# compiler
CONFIG_DEBUG_OPTIMIZATIONS=y

# console
CONFIG_CONSOLE=y

# UART console
CONFIG_SERIAL=y
CONFIG_UART_CONSOLE=y

# logging
CONFIG_LOG=y
# CONFIG_APP_LOG_LEVEL_DBG=y

# segger RTT console
CONFIG_USE_SEGGER_RTT=y
CONFIG_RTT_CONSOLE=y

# Bluetooth 
CONFIG_BT=y
CONFIG_BT_PERIPHERAL=y
CONFIG_BT_DEVICE_NAME="Zephyr-NRF-BLE-App"
```

## src/main.c
```c
#include <zephyr.h>
#include <device.h>
#include <devicetree.h>
#include <drivers/gpio.h>
#include <logging/log.h>
#include "main.h"
#include "ble.h"

/* 1000 msec = 1 sec */
#define SLEEP_TIME_MS   1000

/* The devicetree node identifier for the "led0" alias. */
#define LED0_NODE DT_ALIAS(led0)

#if DT_NODE_HAS_STATUS(LED0_NODE, okay)
#define LED0	DT_GPIO_LABEL(LED0_NODE, gpios)
#define PIN	DT_GPIO_PIN(LED0_NODE, gpios)
#define FLAGS	DT_GPIO_FLAGS(LED0_NODE, gpios)
#else
/* A build error here means your board isn't set up to blink an LED. */
#error "Unsupported board: led0 devicetree alias is not defined"
#define LED0	""
#define PIN	0
#define FLAGS	0
#endif

LOG_MODULE_REGISTER(nrf_ble_app);

void main(void)
{
	const struct device *dev;
	bool led_is_on = true;
	int ret;

	dev = device_get_binding(LED0);
	if (dev == NULL) {
		LOG_INF("Devicetree is NULL");
		LOG_DBG("Devicetree is NULL");
		return;
	}

	ret = gpio_pin_configure(dev, PIN, GPIO_OUTPUT_ACTIVE | FLAGS);
	if (ret < 0) {
		return;
	}

	// Start BLE 
	ble__init_peripheral();

	while (1) {

		LOG_INF("Running Main() \n");
		k_sleep(K_MSEC(1000));

		gpio_pin_set(dev, PIN, (int)led_is_on);
		led_is_on = !led_is_on;
		k_msleep(SLEEP_TIME_MS);
	}
}
```

## include/ble.h
```c
#include <bluetooth/bluetooth.h>
#include <bluetooth/conn.h>
#include <zephyr.h>
#include <sys/printk.h>
#include <logging/log.h>

/**
 * @brief  Initialize BLE peripheral
 * @param  None
 * @return Void
 */
void ble__init_peripheral(void);
```

## src/ble.c
```c
#include "ble.h"

LOG_MODULE_REGISTER(ble, LOG_LEVEL_INF);

static void connected(struct bt_conn *conn, uint8_t err);
static void disconnected(struct bt_conn *conn, uint8_t err);

// Struct with function pointers to callback functions
static struct bt_conn_cb conn_callbacks = {
    .connected = connected,
    .disconnected = disconnected,
};

static const struct bt_data ad[] = {
	BT_DATA_BYTES(BT_DATA_FLAGS, (BT_LE_AD_GENERAL))
};

/**
 * @brief  Initialize BLE
 * @param  conn
 * @param  err
 */
static void connected(struct bt_conn *conn, uint8_t err){
    
    char addr[BT_ADDR_LE_STR_LEN];
	if (err) {
		LOG_INF("Connection failed (err 0x%02x)\n", err);
		return;
	}

	bt_addr_le_to_str(bt_conn_get_dst(conn), addr, sizeof(addr));
	LOG_INF("Connected: %s\n", addr);
}

/**
 * @brief  Disconnect BLE Callback
 * @param  None
 */
static void disconnected(struct bt_conn *conn, uint8_t err){
    
    char addr[BT_ADDR_LE_STR_LEN];
    if (err) {
		LOG_INF("Disconnect failed (err %d)\n", err);
		return;
	}

	bt_addr_le_to_str(bt_conn_get_dst(conn), addr, sizeof(addr));
	LOG_INF("Disconnected: %s\n", addr);

}

void ble__init_peripheral(void){

    LOG_INF("Initializing BLE\n");

    int err;

	err = bt_enable(NULL);
	if (err) {
		LOG_INF("Bluetooth init failed (err %d)\n", err);
		return;
	}

    // Create callbacks for handling connection and disconnection events
    bt_conn_cb_register(&conn_callbacks);

    // Start advertising
    err = bt_le_adv_start(BT_LE_ADV_CONN_NAME, ad, ARRAY_SIZE(ad), NULL, 0);
	if (err) {
		LOG_INF("Advertising failed to start (err %d)\n", err);
		return;
	}

	LOG_INF("Advertising successfully started\n");

    //Register services
}
```

## src/main.h
```c
#include <zephyr.h>
#include <device.h>
#include <devicetree.h>
#include <drivers/gpio.h>
#include <logging/log.h>

/* 1000 msec = 1 sec */
#define SLEEP_TIME_MS   1000

/* The devicetree node identifier for the "led0" alias. */
#define LED0_NODE DT_ALIAS(led0)

#if DT_NODE_HAS_STATUS(LED0_NODE, okay)
#define LED0	DT_GPIO_LABEL(LED0_NODE, gpios)
#define PIN	DT_GPIO_PIN(LED0_NODE, gpios)
#define FLAGS	DT_GPIO_FLAGS(LED0_NODE, gpios)
#else
/* A build error here means your board isn't set up to blink an LED. */
#error "Unsupported board: led0 devicetree alias is not defined"
#define LED0	""
#define PIN	0
#define FLAGS	0
#endif
```
